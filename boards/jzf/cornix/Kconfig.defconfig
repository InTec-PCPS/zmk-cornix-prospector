## boards/jzf/cornix/Kconfig.defconfig
```kconfig
# cornix board configuration

# Copyright (c) 2020 The ZMK Contributors
# SPDX-License-Identifier: MIT

if BOARD_CORNIX_LEFT || BOARD_CORNIX_RIGHT

config ZMK_SPLIT_ROLE_CENTRAL
    default n

config ZMK_SPLIT_BLE_ROLE_CENTRAL
    default n

# Add keyboard debouncing
config ZMK_KSCAN_DEBOUNCE_PRESS_MS
    default 3
config ZMK_KSCAN_DEBOUNCE_RELEASE_MS
    default 3

#config BT_CTLR
#    default BT

config BOARD_CORNIX_CHARGER
    default y

config ZMK_SPLIT
    default y

config ZMK_BLE
    default y

## disable rgb by default
config ZMK_RGB_UNDERGLOW
    default n
config ZMK_RGB_UNDERGLOW_EXT_POWER
    default n

endif # BOARD_CORNIX_LEFT || BOARD_CORNIX_RIGHT
# vim: set ft=kconfig:
```
